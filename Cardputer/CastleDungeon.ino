/*********************************************************************** 
    Castle Dungeon Cardputer

    v 0.60  - Redefine sprites

    v 0.50  - Restructure game/main loop
            - Fixed kill/lost to beast animation
            - Info panel: Items taken, spell on, motion indicators 
            - Player sprite shows direction of motion
            - Modified showSprite() to include transparency
            - Changed spell: off it after 2 steps
        
    v 0.42  Moving to PC (Windows 11)

    *************************************
    TO DO:
    *************************************
    * Countdown timer
    * Victory screen
    *************************************

    Board: M5Cardputer
        (1) File --> Preferences
        (2) Additional Boards Manage URLs: https://m5stack.oss-cn-shenzhen.aliyuncs.com/resource/arduino/package_m5stack_index.json
        (3) OK
        (4) Tools --> Board --> Boards Manager... ==> M5Stack
        (5) Install
    Library:
        (1) Sketch → Include Library → Manage Libraries... ==> M5Cardputer
        (2) Install All
    Settings
        (1) Tools → Board = M5Cardputer
        (2) Tools → Flash size = 8Mb (64MB)
        (3) Tools → Flash Mode = OPI
        (4) Tools → Partition Scheme = 8M with spiffs (3MB APP/1.5MB SPIFFS)
        (5) Tools → PSRAM = OPI PSRAM
        (6) Tools → USB CDC On Boot = Enabled
        
    Screen = 240x135
    Cell/sprite = 45x45 (16*2.8)
    Lighted area = 3*45 x 3*45 = 135x135 pixels

    TOOLS:

    (1) Draw sprites
        https://www.pixel-editor.com

    (2) Convert PNG 8x8 8-bit to C data array
        https://notisrac.github.io/FileToCArray/
        
***********************************************************************/

#include <M5Cardputer.h>

M5Canvas manleft(&M5Cardputer.Display);
M5Canvas manright(&M5Cardputer.Display);
M5Canvas fl00r(&M5Cardputer.Display);
M5Canvas wall(&M5Cardputer.Display);
M5Canvas door(&M5Cardputer.Display);
M5Canvas beast(&M5Cardputer.Display);
M5Canvas pit(&M5Cardputer.Display);
M5Canvas key(&M5Cardputer.Display);
M5Canvas sword(&M5Cardputer.Display);
M5Canvas bomb(&M5Cardputer.Display);
M5Canvas spell(&M5Cardputer.Display);
M5Canvas arrowup(&M5Cardputer.Display);
M5Canvas arrowdown(&M5Cardputer.Display);
M5Canvas arrowleft(&M5Cardputer.Display);
M5Canvas arrowright(&M5Cardputer.Display);

// Data arrays for sprites
static const uint8_t DATAmanleft[] PROGMEM  = {
  0xfb, 0xfb, 0xfb, 0xfb, 0xfb, 0xfb, 0xfb, 0xfb, 0xfb, 0xfb, 0xfb, 0xfb, 0xfb, 0xfb, 0xfb, 0xfb, 
  0xfb, 0xfb, 0xfb, 0xfb, 0xfb, 0xfb, 0xfb, 0x46, 0x46, 0x46, 0xfb, 0xfb, 0xfb, 0xfb, 0xfb, 0xfb, 
  0xfb, 0xfb, 0xfb, 0xfb, 0xfb, 0xfb, 0xfb, 0x46, 0x46, 0x46, 0xfb, 0xfb, 0xfb, 0xfb, 0xfb, 0xfb, 
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  0xfb, 0xfb, 0xfb, 0xfb, 0xfb, 0x46, 0x46, 0x46, 0xfb, 0x46, 0x46, 0xfb, 0xfb, 0xfb, 0xfb, 0xfb
};

static const uint8_t DATAmanright[] PROGMEM  = {
  0xfb, 0xfb, 0xfb, 0xfb, 0xfb, 0xfb, 0xfb, 0xfb, 0xfb, 0xfb, 0xfb, 0xfb, 0xfb, 0xfb, 0xfb, 0xfb, 
  0xfb, 0xfb, 0xfb, 0xfb, 0xfb, 0xfb, 0x46, 0x46, 0x46, 0xfb, 0xfb, 0xfb, 0xfb, 0xfb, 0xfb, 0xfb, 
  0xfb, 0xfb, 0xfb, 0xfb, 0xfb, 0xfb, 0x46, 0x46, 0x46, 0xfb, 0xfb, 0xfb, 0xfb, 0xfb, 0xfb, 0xfb, 
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  0xfb, 0xfb, 0xfb, 0xfb, 0xfb, 0x46, 0x46, 0xfb, 0x46, 0x46, 0x46, 0xfb, 0xfb, 0xfb, 0xfb, 0xfb
};

static const uint8_t DATAfl00r[] PROGMEM  = {
  0xfb, 0xfb, 0xfb, 0xfb, 0xfb, 0xfb, 0xfb, 0xfb, 0xfb, 0xfb, 0xfb, 0xfb, 0xfb, 0xfb, 0xfb, 0xfb, 
  0xfb, 0xfb, 0xfb, 0xfb, 0xfb, 0xfb, 0xfb, 0xfb, 0xfb, 0xfb, 0xfb, 0xfb, 0xfb, 0xfb, 0xfb, 0xfb, 
  0xfb, 0xfb, 0xfb, 0xfb, 0xfb, 0xfb, 0xfb, 0xfb, 0xfb, 0xfb, 0xfb, 0xfb, 0xfb, 0xfb, 0xfb, 0xfb, 
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  0xfb, 0xfb, 0xfb, 0xfb, 0xfb, 0xfb, 0xfb, 0xfb, 0xfb, 0xfb, 0xfb, 0xfb, 0xfb, 0xfb, 0xfb, 0xfb
};

// array size is 256
static const uint8_t DATAwall[] PROGMEM  = {
  0x46, 0x46, 0x46, 0x46, 0x46, 0x46, 0x46, 0x46, 0x46, 0x46, 0x46, 0xfb, 0x46, 0x46, 0x46, 0x46, 
  0x46, 0x46, 0x46, 0x46, 0x46, 0x46, 0x46, 0x46, 0x46, 0x46, 0x46, 0xfb, 0x46, 0x46, 0x46, 0x46, 
  0x46, 0x46, 0x46, 0x46, 0x46, 0x46, 0x46, 0x46, 0x46, 0x46, 0x46, 0xfb, 0x46, 0x46, 0x46, 0x46, 
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  0xfb, 0xfb, 0xfb, 0xfb, 0xfb, 0xfb, 0xfb, 0xfb, 0xfb, 0xfb, 0xfb, 0xfb, 0xfb, 0xfb, 0xfb, 0xfb
};

static const uint8_t DATAdoor[] PROGMEM  = {
  0xfb, 0xfb, 0xfb, 0xfb, 0xfb, 0xfb, 0xfb, 0xfb, 0xfb, 0xfb, 0xfb, 0xfb, 0xfb, 0xfb, 0xfb, 0xfb, 
  0xfb, 0xfb, 0xfb, 0xfb, 0xfb, 0xfb, 0xfb, 0xfb, 0xfb, 0xfb, 0xfb, 0xfb, 0xfb, 0xfb, 0xfb, 0xfb, 
  0xfb, 0xfb, 0xfb, 0xfb, 0xfb, 0xfb, 0xfb, 0xfb, 0xfb, 0xfb, 0xfb, 0xfb, 0xfb, 0xfb, 0xfb, 0xfb, 
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  0xfb, 0xfb, 0xfb, 0xfb, 0xfb, 0xfb, 0xfb, 0xfb, 0xfb, 0xfb, 0xfb, 0xfb, 0xfb, 0xfb, 0xfb, 0xfb
};

static const uint8_t DATApit[] PROGMEM  = {
  0xfb, 0xfb, 0xfb, 0xfb, 0xfb, 0xfb, 0xfb, 0xfb, 0xfb, 0xfb, 0xfb, 0xfb, 0xfb, 0xfb, 0xfb, 0xfb, 
  0xfb, 0xfb, 0xfb, 0xfb, 0xfb, 0xfb, 0xfb, 0xfb, 0xfb, 0xfb, 0xfb, 0xfb, 0xfb, 0xfb, 0xfb, 0xfb, 
  0xfb, 0xfb, 0xfb, 0xfb, 0xfb, 0xfb, 0xfb, 0xfb, 0xfb, 0xfb, 0xfb, 0xfb, 0xfb, 0xfb, 0xfb, 0xfb, 
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  0xfb, 0xfb, 0xfb, 0xfb, 0xfb, 0xfb, 0xfb, 0xfb, 0xfb, 0xfb, 0xfb, 0xfb, 0xfb, 0xfb, 0xfb, 0xfb
};

static const uint8_t DATAbeast[] PROGMEM  = {
  0xfb, 0xfb, 0xfb, 0xfb, 0xfb, 0xfb, 0xfb, 0xfb, 0xfb, 0xfb, 0xfb, 0xfb, 0xfb, 0xfb, 0xfb, 0xfb, 
  0xfb, 0x00, 0x00, 0xfb, 0xfb, 0xfb, 0xfb, 0xfb, 0xfb, 0xfb, 0xfb, 0xfb, 0xfb, 0x00, 0x00, 0xfb, 
  0xfb, 0xfb, 0x00, 0x00, 0x00, 0xfb, 0xfb, 0x00, 0x00, 0xfb, 0xfb, 0x00, 0x00, 0x00, 0xfb, 0xfb, 
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  0xfb, 0xfb, 0xfb, 0xfb, 0xfb, 0xfb, 0xfb, 0xfb, 0xfb, 0xfb, 0xfb, 0xfb, 0xfb, 0xfb, 0xfb, 0xfb
};

static const uint8_t DATAkey[] PROGMEM  = {
  0xfb, 0xfb, 0xfb, 0xfb, 0xfb, 0xfb, 0xfb, 0xfb, 0xfb, 0xfb, 0xfb, 0xfb, 0xfb, 0xfb, 0xfb, 0xfb, 
  0xfb, 0xfb, 0xfb, 0xfb, 0xfb, 0xfb, 0xfb, 0xfb, 0xfb, 0xfb, 0xfb, 0xfb, 0xfb, 0xfb, 0xfb, 0xfb, 
  0xfb, 0xfb, 0xfb, 0xfb, 0xfb, 0xfb, 0xfb, 0xfb, 0xfb, 0xfb, 0xfb, 0xfb, 0xfb, 0xfb, 0xfb, 0xfb, 
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  0xfb, 0xfb, 0xfb, 0xfb, 0xfb, 0xfb, 0xfb, 0xfb, 0xfb, 0xfb, 0xfb, 0xfb, 0xfb, 0xfb, 0xfb, 0xfb
};

static const uint8_t DATAsword[] PROGMEM  = {
  0xfb, 0xfb, 0xfb, 0xfb, 0xfb, 0xfb, 0xfb, 0xfb, 0xfb, 0xfb, 0xfb, 0xfb, 0xfb, 0xfb, 0xfb, 0xfb, 
  0xfb, 0xfb, 0xfb, 0xfb, 0xfb, 0xfb, 0xfb, 0xfb, 0xfb, 0xfb, 0xfb, 0xfb, 0xfb, 0x00, 0x00, 0xfb, 
  0xfb, 0xfb, 0xfb, 0xfb, 0xfb, 0xfb, 0xfb, 0xfb, 0xfb, 0xfb, 0xfb, 0xfb, 0x00, 0xff, 0x00, 0xfb, 
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  0xfb, 0xfb, 0xfb, 0xfb, 0xfb, 0xfb, 0xfb, 0xfb, 0xfb, 0xfb, 0xfb, 0xfb, 0xfb, 0xfb, 0xfb, 0xfb
};

static const uint8_t DATAbomb[] PROGMEM  = {
  0xfb, 0xfb, 0xfb, 0xfb, 0xfb, 0xfb, 0xfb, 0xfb, 0xfb, 0xfb, 0xfb, 0xe9, 0xe9, 0xfb, 0xe9, 0xe9, 
  0xfb, 0xfb, 0xfb, 0xfb, 0xfb, 0xfb, 0xfb, 0xfb, 0xfb, 0xe9, 0xfb, 0xe9, 0xe9, 0xfb, 0xe9, 0xe9, 
  0xfb, 0xfb, 0xfb, 0xfb, 0xfb, 0xfb, 0xfb, 0xfb, 0xe9, 0xfb, 0xfb, 0xfb, 0xfb, 0xfb, 0xfb, 0xfb, 
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  0xfb, 0xfb, 0xfb, 0xfb, 0xfb, 0xfb, 0xfb, 0xfb, 0xfb, 0xfb, 0xfb, 0xfb, 0xfb, 0xfb, 0xfb, 0xfb
};

static const uint8_t DATAspell[] PROGMEM  = {
  0xfb, 0xfb, 0xfb, 0xfb, 0xfb, 0xfb, 0xfb, 0xfb, 0xfb, 0xfb, 0xfb, 0xfb, 0xfb, 0xfb, 0xfb, 0xfb, 
  0xfb, 0xfb, 0xfb, 0xfb, 0xfb, 0xfb, 0xfb, 0xe9, 0xe9, 0xfb, 0xfb, 0xfb, 0xfb, 0xfb, 0xfb, 0xfb, 
  0xfb, 0xfb, 0xfb, 0xe9, 0xfb, 0xfb, 0xfb, 0xe9, 0xe9, 0xfb, 0xfb, 0xfb, 0xe9, 0xfb, 0xfb, 0xfb, 
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  0xfb, 0xfb, 0xfb, 0xfb, 0xfb, 0xfb, 0xfb, 0xfb, 0xfb, 0xfb, 0xfb, 0xfb, 0xfb, 0xfb, 0xfb, 0xfb
};

static const uint8_t DATAarrowup[] PROGMEM  = {
  0xfb, 0xfb, 0xfb, 0xfb, 0xfb, 0xfb, 0xfb, 0xfb, 0xfb, 0xfb, 0xfb, 0xfb, 0xfb, 0xfb, 0xfb, 0xfb, 
  0xfb, 0xfb, 0xfb, 0xfb, 0xfb, 0xfb, 0xfb, 0xfb, 0xfb, 0xfb, 0xfb, 0xfb, 0xfb, 0xfb, 0xfb, 0xfb, 
  0xfb, 0xfb, 0xfb, 0xfb, 0xfb, 0xfb, 0xfb, 0xfb, 0xfb, 0xfb, 0xfb, 0xfb, 0xfb, 0xfb, 0xfb, 0xfb, 
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  0xfb, 0xfb, 0xfb, 0xfb, 0xfb, 0xfb, 0xfb, 0xfb, 0xfb, 0xfb, 0xfb, 0xfb, 0xfb, 0xfb, 0xfb, 0xfb
};

static const uint8_t DATAarrowdown[] PROGMEM  = {
  0xfb, 0xfb, 0xfb, 0xfb, 0xfb, 0xfb, 0xfb, 0xfb, 0xfb, 0xfb, 0xfb, 0xfb, 0xfb, 0xfb, 0xfb, 0xfb, 
  0xfb, 0xfb, 0xfb, 0xfb, 0xfb, 0xfb, 0xfb, 0xfb, 0xfb, 0xfb, 0xfb, 0xfb, 0xfb, 0xfb, 0xfb, 0xfb, 
  0xfb, 0xfb, 0xfb, 0xfb, 0xfb, 0xfb, 0xfb, 0xfb, 0xfb, 0xfb, 0xfb, 0xfb, 0xfb, 0xfb, 0xfb, 0xfb, 
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  0xfb, 0xfb, 0xfb, 0xfb, 0xfb, 0xfb, 0xfb, 0xfb, 0xfb, 0xfb, 0xfb, 0xfb, 0xfb, 0xfb, 0xfb, 0xfb
};

static const uint8_t DATAarrowleft[] PROGMEM  = {
  0xfb, 0xfb, 0xfb, 0xfb, 0xfb, 0xfb, 0xfb, 0xfb, 0xfb, 0xfb, 0xfb, 0xfb, 0xfb, 0xfb, 0xfb, 0xfb, 
  0xfb, 0xfb, 0xfb, 0xfb, 0xfb, 0xfb, 0xfb, 0xfb, 0xfb, 0xfb, 0xe9, 0xfb, 0xfb, 0xfb, 0xfb, 0xfb, 
  0xfb, 0xfb, 0xfb, 0xfb, 0xfb, 0xfb, 0xfb, 0xfb, 0xfb, 0xe9, 0xe9, 0xfb, 0xfb, 0xfb, 0xfb, 0xfb, 
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  0xfb, 0xfb, 0xfb, 0xfb, 0xfb, 0xfb, 0xfb, 0xfb, 0xfb, 0xfb, 0xfb, 0xfb, 0xfb, 0xfb, 0xfb, 0xfb
};

static const uint8_t DATAarrowright[] PROGMEM  = {
  0xfb, 0xfb, 0xfb, 0xfb, 0xfb, 0xfb, 0xfb, 0xfb, 0xfb, 0xfb, 0xfb, 0xfb, 0xfb, 0xfb, 0xfb, 0xfb, 
  0xfb, 0xfb, 0xfb, 0xfb, 0xfb, 0xe9, 0xfb, 0xfb, 0xfb, 0xfb, 0xfb, 0xfb, 0xfb, 0xfb, 0xfb, 0xfb, 
  0xfb, 0xfb, 0xfb, 0xfb, 0xfb, 0xe9, 0xe9, 0xfb, 0xfb, 0xfb, 0xfb, 0xfb, 0xfb, 0xfb, 0xfb, 0xfb, 
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  0xfb, 0xfb, 0xfb, 0xfb, 0xfb, 0xfb, 0xfb, 0xfb, 0xfb, 0xfb, 0xfb, 0xfb, 0xfb, 0xfb, 0xfb, 0xfb
};

// Game's constants, arrays & variables
const uint8_t TRACOL = 0xfb;
const uint8_t XOFF = 105; 
const uint8_t X = 45, Y = 45;
const int ROW = 20, COL = 21;
int row, col;
bool playgame = true; 
bool gameover;
bool ukey, usword;
int  uspell, ubombs;
int  facing = 1;
// Variables for timer
unsigned long prevMillis = 0;
const long INTERVAL = 1000;   // Interval in milliseconds (1 second)
const long SECONDS = 300;     // Game time = 5 minutes
int secondsLeft;   

// The game maze + empty maze remplate
char maze[ROW][COL];
const char emptyMaze[ROW][COL] = {
  "####################",
  "#..#..#     #      #",
  "#..#..# ### # ##-# #",
  "#-###-# #   # #..# #",
  "# #   # # ###-#..# #",
  "# # # # #  #..#### #",
  "#   # #-## #..#    #",
  "##### #..# #### ####",
  "#     #..# #..# #..#",
  "# ###-#### #..# #..#",
  "# #......# ##-# ##-#",
  "# ########         #",
  "#          ####### #",
  "# ## ## ####       #",
  "####  # #..# #####-#",
  "#..####-#..# # #...#",
  "#..#....##-# # #####",
  "#-######## #    ...#",
  "#            #######",
  "####################"
};

// A happy tune
int happy[9] = {659,659,659,0,523,659,784,0,392};

// ================================= S E T U P ==================================
void setup() 
{
  auto cfg = M5.config();
  M5Cardputer.begin(cfg);
  M5Cardputer.Speaker.begin();

  // Debug sound
  //sfxWootwoot();
  //delay(3000);
  //sfxLevitate();
  //delay(3000);

  // Create sprite matching your array dimensions (width, height)
  setupSprite(manleft,  DATAmanleft);
  setupSprite(manright, DATAmanright);
  setupSprite(fl00r,    DATAfl00r);
  setupSprite(wall,     DATAwall);
  setupSprite(door,     DATAdoor);
  setupSprite(beast,    DATAbeast);
  setupSprite(pit,      DATApit);
  setupSprite(key,      DATAkey);
  setupSprite(sword,    DATAsword);
  setupSprite(bomb,     DATAbomb);
  setupSprite(spell,    DATAspell);
  setupSprite(arrowup,    DATAarrowup);
  setupSprite(arrowdown,  DATAarrowdown);
  setupSprite(arrowleft,  DATAarrowleft);
  setupSprite(arrowright, DATAarrowright);
  
  // Set text size 18x24 pixels
  M5Cardputer.Display.setTextSize(3);
  M5.Display.setTextColor(RED, BLACK);
  M5Cardputer.Display.drawString("Castle", 66, 48);
  M5Cardputer.Display.drawString("Dungeon", 57, 72);

  for(int n=0; n<6; n++) {
    M5Cardputer.Speaker.tone(500+100*n, 300); 
    delay(400);
  }
  waitKey(1);

  // Set text size 12x16 pixels
  M5Cardputer.Display.setTextSize(2);
  M5Cardputer.Display.fillScreen(BLACK);
  M5.Display.setTextColor(CYAN, BLACK);

  // Display instruction
  M5Cardputer.Display.setCursor(0, 0);
  M5Cardputer.Display.printf("Find and defuse the\n");
  M5Cardputer.Display.printf("bombs hidden in the\n");
  M5Cardputer.Display.printf("dungeon.\n\n"); 
  M5Cardputer.Display.printf("Don't fall into a\n");
  M5Cardputer.Display.printf("a pit or get eaten\n");
  M5Cardputer.Display.printf("by a beast.");
  waitKey(3);
  M5Cardputer.Display.fillScreen(BLACK);
  M5.Display.setTextColor(YELLOW, BLACK);
  M5Cardputer.Display.setCursor(0, 0);
  M5Cardputer.Display.printf("Press the L key for\n");
  M5Cardputer.Display.printf("a levitation spell.\n\n");
  M5Cardputer.Display.printf("You have 5 minutes\n");
  M5Cardputer.Display.printf("to complete your\n");
  M5Cardputer.Display.printf("quest...");
  waitKey(3);
  M5Cardputer.Display.fillScreen(BLACK);
}

// ----------------------------------------------------------------------------
void setupSprite(M5Canvas &s, const uint8_t *data) 
{
  s.createSprite(16, 16);
  s.setColorDepth(8);
  s.pushImage(0, 0, 16, 16, data);
  s.setPivot(0, 0);
}

// ================================= M A I N ====================================
void loop() 
{
  int  r = 0, c = 0;
  char ch;
  unsigned long currMillis;
  
  while( playgame ) {
    setupMaze();
    resetGameVars();

    while( !gameover ) {

      readKeyboard( &r, &c );
      ch = maze[row+r][col+c];
      switch( ch ) {
        case ' ': 
                  if( c || r ) sfxStep();
                  break;
        case '#': 
                  r = 0;
                  c = 0;
                  sfxBumped();
                  break;
        case '!': 
                  removeItem( row+r, col+c );
                  usword = true;
                  sword.pushRotateZoom(2, 2, 0, 2, 2, TRACOL);
                  break;
        case '+': 
                  removeItem( row+r, col+c );
                  ukey = true;
                  key.pushRotateZoom(34, 2, 0, 2, 2, TRACOL);
                  break;
        case '*': 
                  removeItem( row+r, col+c );
                  ubombs++;
                  if( ubombs>0 ) bomb.pushRotateZoom(2, 34, 0, 2, 2, TRACOL);
                  if( ubombs>1 ) bomb.pushRotateZoom(36, 34, 0, 2, 2, TRACOL);
                  if( ubombs>2 ) bomb.pushRotateZoom(70, 34, 0, 2, 2, TRACOL);
                  break;
        case '@':
                  if( uspell==0 ) {
                    pitFall( r, c );
                    gameover = true;
                  }
                  else if( uspell==1 ) levitate( r, c );
                  break;
        case '&':
                  if( usword ) 
                    killBeast( r, c );
                  else {
                    beastLost( r, c );
                    gameover = true;
                  }
                  break;
        case '-':
                  if( ukey ) { 
                    sfxOpenDoor();
                    maze[row+r][col+c] = ' ';
                  }
                  else {
                    doorBumped( r );
                    r = 0;
                    c = 0;
                  }
      } // switch-case
      // Cancel spell after 1 step
      if( r || c ) {
        if( uspell==2 ) {
          uspell = 0;
          M5Cardputer.Display.fillRect(2*34+2, 2, 30, 30, DARKGREY);
        }
        if( uspell==1 ) uspell = 2;
      }
      row = row + r;
      col = col + c;
  
      // Update/check timer
      currMillis = millis();
      if( currMillis - prevMillis >= INTERVAL ) {
        prevMillis = currMillis;
        secondsLeft--;
        M5Cardputer.Display.setCursor(0, 72);
        M5Cardputer.Display.printf("%d ", secondsLeft);
        if( secondsLeft <= 0 ) {
          timesUp();
          gameover = true;
        }
      }
      // Refresh display
      updateDisplay( ch );
      // Check number of bombs collected
      if( ubombs==3 ) { 
          castleSaved();
          gameover = true;
      }
      delay(100);
    } // while !gameover
    
    playgame = playAgain();
    
  } // while playgame
 
  M5Cardputer.Display.fillScreen(BLACK);
}

// ----------------------------------------------------------------------------
void setupMaze()
{
  for( int r=0; r<ROW; r++ ) {
    for( int c=0; c<COL; c++ ) {
      maze[r][c] = emptyMaze[r][c];
    }
  }
  
  // Place items at random places in maze
  placeItemRoom('*', 3);  // Bombs
  placeItemRoom('&',12);  // Beasts
  placeItem('@', 3);      // Pits
  placeItem('+', 1);      // Key
  placeItem('!', 1);      // Sword

  // Setup info box on left
  M5Cardputer.Display.fillRect(0, 0, 104, 135, BLACK);
  for( int r=0; r<2; r++ )
    for( int c=0; c<3; c++ )
      M5Cardputer.Display.fillRect(c*34+2, r*34+2, 30, 30, DARKGREY);

  // Set default text size & colours
  M5.Display.setTextColor(YELLOW, BLACK);
  M5Cardputer.Display.setTextSize(2);
}

// ----------------------------------------------------------------------------
void resetGameVars()
{
  // Set initial player's position in maze
  do {
    row = esp_random()%ROW;
    col = esp_random()%ROW;
  } while( maze[row][col] != ' ');

  // For debugging...
  //row = 18; col = 2; 
  //maze[18][4] = '@'; 
  //maze[18][5] = '!'; 
  //maze[18][7] = '*'; 
  //maze[18][8] = '*'; 
  
  // Reset game variables
  playgame = true;
  gameover = false;
  uspell = 0;
  ukey = false;
  usword = false;
  ubombs = 0;
  prevMillis = millis();
  secondsLeft = SECONDS;
}

// ----------------------------------------------------------------------------
void placeItem( char c, int n )
{
  int row, col, i;

  for( i=0; i<n; i++ ) {
    do {
      row = esp_random()%ROW;
      col = esp_random()%ROW;
    } while( maze[row][col] != ' ');
    maze[row][col] = c;
  }
}

// ----------------------------------------------------------------------------
void placeItemRoom( char c, int n )
{
  int row, col, i;

  for( i=0; i<n; i++ ) {
    do {
      row = esp_random()%ROW;
      col = esp_random()%ROW;
    } while( maze[row][col] != '.');
    maze[row][col] = c;
  }
}

// ----------------------------------------------------------------------------
void readKeyboard( int *r, int *c )
{
  char k;
  *r = 0; *c = 0;
  k = getKey();

  if( k != 63 ) {
    M5Cardputer.Display.fillRect(0, 88, 104, 48, BLACK);
    switch( k ) {
      case 59:  *r = -1;
                arrowup.pushRotateZoom(34, 88, 0, 2, 2, TRACOL);
                break;
      case 46:  *r = 1;
                arrowdown.pushRotateZoom(34, 104, 0, 2, 2, TRACOL);
                break;
      case 44:  *c = -1;
                arrowleft.pushRotateZoom(2, 96, 0, 2, 2, TRACOL);
                facing = 0;
                break;
      case 47:  *c = 1;
                arrowright.pushRotateZoom(34*2, 96, 0, 2, 2, TRACOL);
                facing = 1;
                break;
      case 108: uspell = 1;
                sfxWootwoot();
                spell.pushRotateZoom(2*34+2, 0, 0, 2, 2, TRACOL);
                break;
    }
  }
}

// ----------------------------------------------------------------------------
void updateDisplay( char ch ) 
{
  // Top row  
  ch = maze[row-1][col-1];
  showSprite( ch, XOFF, 0, 0 );
  ch = maze[row-1][col];
  showSprite( ch, X+XOFF, 0, 0 );
  ch = maze[row-1][col+1];
  showSprite( ch, X*2+XOFF, 0, 0 );
  // Middle row
  ch = maze[row][col-1];
  showSprite( ch, XOFF, Y, 0 );
  // Middle-centre cell
  ch = maze[row][col];
  int tr = 0;
  if( uspell ) {
    showSprite( ch, X+XOFF, Y, 0 );
    tr = 1;
  }
  // Show player's sprite in the middle-centre
  if( facing ) ch = 'R';
  else ch = 'L';
  showSprite( ch, X+XOFF, Y, tr);
  ch = maze[row][col+1];
  showSprite( ch, X*2+XOFF, Y, 0 );
  // Bottom row
  ch = maze[row+1][col-1];
  showSprite( ch, XOFF, Y*2, 0 );
  ch = maze[row+1][col];
  showSprite( ch, X+XOFF, Y*2, 0 );
  ch = maze[row+1][col+1];
  showSprite( ch, X*2+XOFF, Y*2, 0 ); 

  // Show timer
  //M5Cardputer.Display.setCursor(0, Y*2);
  //M5Cardputer.Display.printf("%d", secondsLeft);
  //M5.Display.setTextColor(ORANGE, BLACK);
  //M5Cardputer.Display.drawString("YOU LOST", 0, 32);
 }

// ----------------------------------------------------------------------------
void showSprite( char ch, int x, int y, int transparent ) 
{
  switch( ch ) {
    case '#': if( transparent ) wall.pushRotateZoom(x, y, 0, 2.8, 2.8, TRACOL);
              else wall.pushRotateZoom(x, y, 0, 2.8, 2.8);
              break;
    case ' ':
    case '.': if( transparent ) fl00r.pushRotateZoom(x, y, 0, 2.8, 2.8, TRACOL);
              else fl00r.pushRotateZoom(x, y, 0, 2.8, 2.8);
              break;
    case '&': if( transparent ) beast.pushRotateZoom(x, y, 0, 2.8, 2.8, TRACOL);
              else beast.pushRotateZoom(x, y, 0, 2.8, 2.8);
              break;
    case '*': if( transparent ) bomb.pushRotateZoom(x, y, 0, 2.8, 2.8, TRACOL);
              else bomb.pushRotateZoom(x, y, 0, 2.8, 2.8);
              break;
    case '@': if( transparent ) pit.pushRotateZoom(x, y, 0, 2.8, 2.8, TRACOL);
              else pit.pushRotateZoom(x, y, 0, 2.8, 2.8);
              break;
    case '-': if( transparent ) door.pushRotateZoom(x, y, 0, 2.8, 2.8, TRACOL);
              else door.pushRotateZoom(x, y, 0, 2.8, 2.8);
              break;
    case '+': if( transparent ) key.pushRotateZoom(x, y, 0, 2.8, 2.8, TRACOL);
              else key.pushRotateZoom(x, y, 0, 2.8, 2.8);
              break;
    case '!': if( transparent ) sword.pushRotateZoom(x, y, 0, 2.8, 2.8, TRACOL);
              else sword.pushRotateZoom(x, y, 0, 2.8, 2.8);
              break;
    case '$': if( transparent ) manleft.pushRotateZoom(x, y, 0, 2.8, 2.8, TRACOL);
              else manleft.pushRotateZoom(x, y, 0, 2.8, 2.8);
              break;
    case 'L': if( transparent ) manleft.pushRotateZoom(x, y, 0, 2.8, 2.8, TRACOL);
              else manleft.pushRotateZoom(x, y, 0, 2.8, 2.8);
              break;
    case 'R': if( transparent ) manright.pushRotateZoom(x, y, 0, 2.8, 2.8, TRACOL);
              else manright.pushRotateZoom(x, y, 0, 2.8, 2.8);
              break;
  }
}

// ----------------------------------------------------------------------------
void removeItem( int rr, int cc )
{
  maze[rr][cc] = ' ';
  M5Cardputer.Speaker.tone(1000, 100);
  delay(100);
  M5Cardputer.Speaker.tone(1500, 200);  
  delay(100);
}

// ----------------------------------------------------------------------------
void killBeast( int r, int c )
{
  maze[row+r][col+c] = ' ';
  showSprite( ' ', X+XOFF, Y, 0 );
  showSprite( '$', XOFF+X*(1+0.5*c), Y*(1+0.5*r), 1 );
  //man.pushRotateZoom( XOFF+X*(1+0.5*c), Y*(1+0.5*r), 0, 2.8, 2.8, TRACOL);
  sfxBeast();
  showSprite('$', XOFF+X*(1+0.5*c), Y*(1+0.5*r), 0 );
  //delay(500);
}

// ----------------------------------------------------------------------------
void timesUp()
{
  int n;
  for( int n=20; n>0; n-- ) {
    M5Cardputer.Speaker.tone(500+n*50, 100);
    delay(100);
  }
  M5.Display.setTextColor(RED, BLACK);
  M5Cardputer.Display.setTextSize(3);
  M5Cardputer.Display.drawString("TIME'S UP!", 0, 32);
  M5Cardputer.Display.setTextSize(2);
  M5Cardputer.Display.drawString("CASTLE DESTROYED", 0, 62);
  delay(3000);
}

// ----------------------------------------------------------------------------
void beastLost( int r, int c )
{
  showSprite( ' ', X+XOFF, Y, 0 );
  showSprite( '$', XOFF+X*(1+0.5*c), Y*(1+0.5*r), 1 );
  //man.pushRotateZoom( XOFF+X*(1+0.5*c), Y*(1+0.5*r), 0, 2.8, 2.8, TRACOL);
  sfxBeast();
  showSprite( ' ', XOFF+X*(1+0.5*c), Y*(1+0.5*r), 0 );
  showSprite( '&', XOFF+X+X*c, Y+Y*r, 0);
  delay(1000);
  M5Cardputer.Display.setTextSize(3);
  M5.Display.setTextColor(ORANGE, BLACK);
  M5Cardputer.Display.drawString("YOU LOST", 0, 32);
  M5Cardputer.Display.drawString("TO A BEAST!", 0, 62);
  delay(3000);
}

// ----------------------------------------------------------------------------
void pitFall( int r, int c )
{
  showSprite( ' ', X+XOFF, Y, 0 );
  showSprite( '$', XOFF+X*(1+c), Y*(1+r), 1 );
  sfxPitfall();
  M5Cardputer.Display.setTextSize(3);
  M5.Display.setTextColor(ORANGE, BLACK);
  M5Cardputer.Display.drawString("YOU FELL", 0, 32);
  M5Cardputer.Display.drawString("INTO A PIT!", 0, 62);
  delay(3000);
}

// ----------------------------------------------------------------------------
// Levitating
void levitate( int r, int c)
{
  M5Cardputer.Speaker.tone(1000, 100);
  showSprite( ' ', X+XOFF, Y, 0 );
  if( facing ) showSprite( 'R', XOFF+X*(1+0.5*c), Y*(1+0.5*r), 1 );
  else showSprite( 'L', XOFF+X*(1+0.5*c), Y*(1+0.5*r), 1 );
  delay(200);
  M5Cardputer.Speaker.tone(2000, 100);
  delay(200);
}

// ----------------------------------------------------------------------------
void doorBumped(int r)
{
  showSprite( ' ', X+XOFF, Y, 0 );
  showSprite( '$', X+XOFF, Y*(1+0.5*r), 1 );
  //man.pushRotateZoom(X+XOFF, Y*(1+0.5*r), 0, 2.8, 2.8, TRACOL);
  sfxBumped();
  showSprite( ' ', X+XOFF, Y*(1+0.5*r), 0 );
  showSprite( '$', X+XOFF, Y, 0 );
}

// ----------------------------------------------------------------------------
void castleSaved()
{
  M5Cardputer.Display.setTextSize(3);
  delay(1000);
  M5.Display.setTextColor(GREEN, BLACK);
  M5Cardputer.Display.drawString("YOU SAVED", 21, 48);
  M5Cardputer.Display.drawString("THE CASTLE", 18, 72);
  for( int i=0; i<2; i++)
    sfxHappy();
}

// ----------------------------------------------------------------------------
bool playAgain()
{
  char k;
  M5Cardputer.Display.setTextSize(3);
  M5Cardputer.Display.fillScreen(BLACK);
  M5.Display.setTextColor(YELLOW, BLACK);
  M5Cardputer.Display.drawString("Play again?", 21, 48);
  M5Cardputer.Display.drawString("(Y/N)", 67, 96);
  
  while(1) {
    k = getKey();
    if( k ) M5Cardputer.Speaker.tone(700, 200);
    if( k=='y' || k=='Y' ) return true;
    if( k=='n' || k=='N' ) return false;
  }
  return false; 
}

// ----------------------------------------------------------------------------
void waitKey( int sec )
{
  char k = 0;

  for( int i=0; i<sec*10; i++ ) {
    k = getKey();
    if( k ) return;
    delay(100);
  }
}

// ----------------------------------------------------------------------------
char getKey()
{
  char k = 0;
  M5Cardputer.update(); 
  if (M5Cardputer.Keyboard.isChange()) {
    if (M5Cardputer.Keyboard.isPressed()) {
      Keyboard_Class::KeysState status = M5Cardputer.Keyboard.keysState();
        if (status.word.size() > 0) {
          k = status.word[0]; // Grab the character
        }        
    }
  }
  return k;
}

// ----------------------------------------------------------------------------
void sfxStep( void )
{
  M5Cardputer.Speaker.tone(500, 200);
  delay(100);
}

// ----------------------------------------------------------------------------
void sfxBumped( void )
{
  M5Cardputer.Speaker.tone(700, 200);
  delay(100);
}

// ----------------------------------------------------------------------------
void sfxOpenDoor( void )
{
  int f, n;
  for( n=0; n<5; n++) {
    f = 1000+n*100;
    M5Cardputer.Speaker.tone(f, 100);
    delay(100);
  }
}

// ----------------------------------------------------------------------------
// Levitation spell sound fx
void sfxWootwoot( void )
{
  for( int i=0; i<2; i++ ) {
    for( int n=0; n<10; n++ ) {
      int f = n*20+1000;
      M5Cardputer.Speaker.tone(f, 30);
      delay(30);
    }
  }
}

// ----------------------------------------------------------------------------
void sfxPitfall( void )
{
  int f, n;
  for( n=0; n<15; n++) {
    f = 1200-n*50;
    M5Cardputer.Speaker.tone(f, 100);
    delay(100);
  }
}

// ----------------------------------------------------------------------------
void sfxBeast( void )
{
  int f, n;
  for( int n=0; n<20; n++ ) {
    M5Cardputer.Speaker.tone(500+n*50, 50);
    delay(50);
  }
  for( int n=20; n>0; n-- ) {
    M5Cardputer.Speaker.tone(500+n*50, 50);
    delay(50);
  }
  delay(200);
}

// ----------------------------------------------------------------------------
void sfxHappy( void )
{
  int f, n;
  for( n=0; n<9; n++) {
    f = happy[n];
    M5Cardputer.Speaker.tone(f, 250);
    delay(300);
  }
}
// ==================================== E N D ==================================
